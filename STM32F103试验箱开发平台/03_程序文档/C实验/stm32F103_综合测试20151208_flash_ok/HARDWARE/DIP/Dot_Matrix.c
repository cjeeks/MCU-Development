#include "Dot_Matrix.h"

const unsigned char ziku_table[]={
	
0xFF,0xF7,0x80,0xF5,0xEB,0xF5,0xEB,0xC1,0x80,0xF5,0xAA,0xF6,0xAA,0xF7,0xAA,0x80,
0x8A,0xFF,0xBC,0xFF,0xBE,0xC1,0x80,0xDD,0xBE,0xDD,0xBE,0xDD,0x80,0xC1,0xBE,0xDD,/*"?",0*/

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0xBF,0xBD,0xBC,0xBD,0xBB,0xBD,0xB7,0xBD,0xAF,0x01,0x1F,0xFF,0xBF,0xFF,0xFF,0xFF,/*"?",19*/


};



Gpio_Info DP_info[DP_NUMBER]={
    {D_RCC,D_GPIO,D_GPIO_PIN},
    {C_RCC,C_GPIO,C_GPIO_PIN},
    {B_RCC,B_GPIO,B_GPIO_PIN},
    {A_RCC,A_GPIO,A_GPIO_PIN},
		{G_RCC,G_GPIO,G_GPIO_PIN},
    {DI_RCC,DI_GPIO,DI_GPIO_PIN},
    {DCLK_RCC,DCLK_GPIO,DCLK_GPIO_PIN},
    {LAT_RCC,LAT_GPIO,LAT_GPIO_PIN}
};

void Dot_Matric_Gpio_Init(void)
{
    uint8_t i;
    GPIO_InitTypeDef  GPIO_InitStructure;
    GPIO_InitStructure.GPIO_Mode = GPIO_Mode_Out_PP;
    GPIO_InitStructure.GPIO_Speed = GPIO_Speed_50MHz;
    for(i=0;i<DP_NUMBER;i++)
    {
        RCC_APB2PeriphClockCmd( DP_info[i].rcc , ENABLE); 
        GPIO_InitStructure.GPIO_Pin = DP_info[i].pin;
        GPIO_Init(DP_info[i].gpio, &GPIO_InitStructure);
        GPIO_WriteBit(DP_info[i].gpio,DP_info[i].pin,Bit_SET);
    }
}

/******************************************************************************************
*函数名称：void ABCD_port(u8 dat)
*
*入口参数：dat
*
*出口参数：无
*
*功能说明：修改ABCD的值
*******************************************************************************************/
void ABCD_port(u8 dat)
{
	if((dat&0x01)==0x00)
		A_ONOFF(Bit_RESET);
	else A_ONOFF(Bit_SET);
	
	if((dat&0x02)==0x00)
		B_ONOFF(Bit_RESET);
	else B_ONOFF(Bit_SET);
	
	if((dat&0x04)==0x00)
		C_ONOFF(Bit_RESET);
	else C_ONOFF(Bit_SET);
	
	if((dat&0x08)==0x00)
		D_ONOFF(Bit_RESET);
	else D_ONOFF(Bit_SET);
}

void Dot_Matrix_test(void)
{
	
	u8  i,j;
	//u8 i;
	u8 data_buff;
	u8 hanzi;
//	u8 han;
	u8 shift=1;	
	
	Dot_Matric_Gpio_Init();
			
	for(shift=0;shift<16;shift++){	//一个字移位16位
			//HC595锁定输出,避免数据传输过程中，屏数据变化从而显示闪烁
			LAT_ONOFF(Bit_RESET);
			DCLK_ONOFF(Bit_RESET);
			//74HC595输出数据Hzk16
			data_buff = ziku_table[hanzi*32+shift*2+1];
			for(i=0;i<8;i++){
				if((data_buff&0x80)!=0) DI_ONOFF(Bit_SET);//DA_in_port = 1;
				else DI_ONOFF(Bit_RESET);//DA_in_port = 0;
				DCLK_ONOFF(Bit_SET);//CLK_port = 1;
				DCLK_ONOFF(Bit_RESET);//CLK_port = 0;
				data_buff <<= 1;
				}
				data_buff = ziku_table[hanzi*32+shift*2];
				for(i=0;i<8;i++)
				{
				if((data_buff&0x01)!=0) DI_ONOFF(Bit_SET);//DA_in_port = 1;
				else DI_ONOFF(Bit_RESET);//DA_in_port = 0;
				DCLK_ONOFF(Bit_SET);//CLK_port = 1;
				DCLK_ONOFF(Bit_RESET);//CLK_port = 0;
				data_buff >>= 1;
				}
			//74HC138输出控制	 
			G_ONOFF(Bit_SET);//EN_port = 1;    //关屏显示，原理为使HC138输出全为1，从而三极管截止，点阵不显示
			ABCD_port(shift);//ABCD_port = (ABCD_port & 0x0f)|(han<<4);  //HC138译码输出
			//ABCD_port(han);//ABCD_port = (ABCD_port & 0x0f)|(han<<4);  //HC138译码输出
			LAT_ONOFF(Bit_SET);//Latch_port = 1; //允许HC595数据输出到Q1-Q8端口
			G_ONOFF(Bit_RESET);//EN_port = 0;    //HC138输出有效，打开显示
			LAT_ONOFF(Bit_RESET);//Latch_port = 0;	//锁定HC595数据输出
	}
	
}
	
