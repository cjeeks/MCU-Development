#include "TFT.h"
#include "msp430f5438a.h"
#include "delay.h"

uint BACK_COLOR, POINT_COLOR;

uint  HDP=479;
uint  HT=531;
uint  HPS=43;
uint  LPS=8;
uchar   HPW=10;

uint  VDP=271;
uint  VT=288;
uint  VPS=12;
uint  FPS=4;
uchar   VPW=10;

const uchar  asc2_1608[1520]={
0x00,0x00,0x00,0x00,0x00,0x00,0x00,0x00,0x00,0x00,0x00,0x00,0x00,0x00,0x00,0x00,
0x00,0x00,0x00,0x08,0x08,0x08,0x08,0x08,0x08,0x08,0x00,0x00,0x18,0x18,0x00,0x00,
0x00,0x48,0x6C,0x24,0x12,0x00,0x00,0x00,0x00,0x00,0x00,0x00,0x00,0x00,0x00,0x00,
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0x0C,0x32,0xC2,0x00,0x00,0x00,0x00,0x00,0x00,0x00,0x00,0x00,0x00,0x00,0x00,0x00,
}; 

#ifdef  Bus_16 //条件编译，16位数据模式  

static void LCD_Writ_Bus(char VH,char VL) //并行数据写入函数
{
    WT_LCD_DataPortH=VH;	
    WT_LCD_DataPortL=VL;		
    CLR_LCD_WR;
    SET_LCD_WR; 
}
#else //条件编译，8位数据模式
static void LCD_Writ_Bus(char VH,char VL) //并行数据写入函数
{	
    WT_LCD_DataPortH=VH;	
    CLR_LCD_WR;
    SET_LCD_WR;
    WT_LCD_DataPortH=VL;		
    CLR_LCD_WR;
    SET_LCD_WR;
}
#endif

void LCD_WR_DATA8(char VH,char VL) //发送数据，8位参数
{
    SET_LCD_RS;
    LCD_Writ_Bus(VH,VL);
}  

void LCD_WR_DATA(int da)
{
    SET_LCD_RS;
    LCD_Writ_Bus(da>>8,da);
}	  

void LCD_WR_REG(int da)	 
{	
    CLR_LCD_RS;
    LCD_Writ_Bus(da>>8,da);
}

static void LCD_WR_REG_DATA(int reg,int da)
{
    LCD_WR_REG(reg);
    LCD_WR_DATA(da);
}

void LCD_Address_set(uint x1,uint y1,uint x2,uint y2)
{ 
  LCD_WR_REG(0x002A);	
  LCD_WR_DATA(x1>>8);	    
  LCD_WR_DATA(x1&0x00ff);
  LCD_WR_DATA(x2>>8);	    
  LCD_WR_DATA(x2&0x00ff);
  LCD_WR_REG(0x002b);	
  LCD_WR_DATA(y1>>8);	    
  LCD_WR_DATA(y1&0x00ff);
  LCD_WR_DATA(y2>>8);	    
  LCD_WR_DATA(y2&0x00ff);
  LCD_WR_REG(0x002c);					 						 
}

void Draw_Circle(uint x0,uint y0,uchar r)
{
  int a,b;
  int di;
  a=0;b=r;	  
  di=3-(r<<1); 
  while(a<=b)
  {
    LCD_DrawPoint(x0-b,y0-a);             //3           
    LCD_DrawPoint(x0+b,y0-a);             //0           
    LCD_DrawPoint(x0-a,y0+b);             //1       
    LCD_DrawPoint(x0-b,y0-a);             //7           
    LCD_DrawPoint(x0-a,y0-b);             //2             
    LCD_DrawPoint(x0+b,y0+a);             //4               
    LCD_DrawPoint(x0+a,y0-b);             //5
    LCD_DrawPoint(x0+a,y0+b);             //6 
    LCD_DrawPoint(x0-b,y0+a);             
    a++;
    if(di<0)di +=4*a+6;	  
    else
    {
      di+=10+4*(a-b);   
      b--;
    } 
    LCD_DrawPoint(x0+a,y0+b);
  }
} 

void LCD_Init(void)
{
  P3OUT|=(BIT1+BIT2+BIT3+BIT6+BIT7);
  P4OUT=0xFF;
  P2OUT=0xFF;
  P1OUT|=BIT2;
  P3DIR|=(BIT1+BIT2+BIT3+BIT6+BIT7);
  P4DIR=0xFF;
  P2DIR=0xFF;
  P1DIR|=BIT2;
  P1OUT|=BIT2;
  
  SET_LCD_CS;
  if(GET_LCD_CS==0)
  {
      LCD_WR_REG_DATA(0,0);
      LCD_ShowString(0,0," ");
      LCD_ShowNum(0,0,0,0);
      LCD_Show2Num(0,0,0,0);
      LCD_DrawPoint_big(0,0);
      LCD_DrawRectangle(0,0,0,0);
      Draw_Circle(0,0,0);
  }

  SET_LCD_REST;
  delay_ms(5);	
  CLR_LCD_REST;
  delay_ms(5);
  SET_LCD_REST;
  SET_LCD_CS;
  SET_LCD_RD;
  SET_LCD_WR;
  delay_ms(5);
  CLR_LCD_CS ;  //打开片选使能

  LCD_WR_REG(0x00E2);	//PLL multiplier, set PLL clock to 120M
  LCD_WR_DATA(0x002d);	//N=0x36 for 6.5M, 0x23 for 10M crystal
  LCD_WR_DATA(0x0002);
  LCD_WR_DATA(0x0004);
  LCD_WR_REG(0x00E0);  // PLL enable
  LCD_WR_DATA(0x0001);
  delay_ms(1);
  LCD_WR_REG(0x00E0);
  LCD_WR_DATA(0x0003);
  delay_ms(5);
  LCD_WR_REG(0x0001);  // software reset
  delay_ms(5);
  LCD_WR_REG(0x00E6);	//PLL setting for PCLK, depends on resolution
  LCD_WR_DATA(0x0000);
  LCD_WR_DATA(0x00ff);
  LCD_WR_DATA(0x00be);

  LCD_WR_REG(0x00B0);	//LCD SPECIFICATION
  LCD_WR_DATA(0x0020);
  LCD_WR_DATA(0x0000);
  LCD_WR_DATA((HDP>>8)&0X00FF);  //Set HDP
  LCD_WR_DATA(HDP&0X00FF);
  LCD_WR_DATA((VDP>>8)&0X00FF);  //Set VDP
  LCD_WR_DATA(VDP&0X00FF);
  LCD_WR_DATA(0x0000);
  delay_ms(5);
  LCD_WR_REG(0x00B4);	//HSYNC
  LCD_WR_DATA((HT>>8)&0X00FF);  //Set HT
  LCD_WR_DATA(HT&0X00FF);
  LCD_WR_DATA((HPS>>8)&0X00FF);  //Set HPS
  LCD_WR_DATA(HPS&0X00FF);
  LCD_WR_DATA(HPW);			   //Set HPW
  LCD_WR_DATA((LPS>>8)&0X00FF);  //SetLPS
  LCD_WR_DATA(LPS&0X00FF);
  LCD_WR_DATA(0x0000);

  LCD_WR_REG(0x00B6);	//VSYNC
  LCD_WR_DATA((VT>>8)&0X00FF);   //Set VT
  LCD_WR_DATA(VT&0X00FF);
  LCD_WR_DATA((VPS>>8)&0X00FF);  //Set VPS
  LCD_WR_DATA(VPS&0X00FF);
  LCD_WR_DATA(VPW);			   //Set VPW
  LCD_WR_DATA((FPS>>8)&0X00FF);  //Set FPS
  LCD_WR_DATA(FPS&0X00FF);

  LCD_WR_REG(0x0036); //rotation
  LCD_WR_DATA(0x0000);
  LCD_WR_REG(0x00F0); //pixel data interface
  LCD_WR_DATA(0x0003);
  
  delay_ms(5);
  LCD_WR_REG(0x0029); //display on
  LCD_WR_REG(0x00BE); //set PWM for B/L
  LCD_WR_DATA(0x0006);
  LCD_WR_DATA(0x00f0);
  LCD_WR_DATA(0x0001);
  LCD_WR_DATA(0x00f0);
  LCD_WR_DATA(0x0000);
  LCD_WR_DATA(0x0000);

  LCD_WR_REG(0x00d0); 
  LCD_WR_DATA(0x000d);
  //----------LCD RESET---GPIO0-------------------//
  LCD_WR_REG(0x00B8);
  LCD_WR_DATA(0x0000);    //GPIO3=input, GPIO[2:0]=output
  LCD_WR_DATA(0x0001);    //GPIO0 normal
  LCD_WR_REG(0x00BA);
  LCD_WR_DATA(0x0000);  
}

void LCD_Clear(uint Color)
{
  uchar VH,VL;
  uint i,j;
  VH=Color>>8;
  VL=Color;	
  LCD_Address_set(0,0,LCD_W-1,LCD_H-1);
  for(i=0;i<LCD_W;i++)
  {
    for (j=0;j<LCD_H;j++)
    {
      LCD_WR_DATA8(VH,VL);
    }
  }
}

void LCD_DrawPoint(uint x,uint y)
{
  LCD_Address_set(x,y,x,y);
  LCD_WR_DATA(POINT_COLOR);  
} 	 

void LCD_DrawPoint_big(uint x,uint y)
{
  LCD_Fill(x-1,y-1,x+1,y+1,POINT_COLOR);
} 

void LCD_Fill(uint xsta,uint ysta,uint xend,uint yend,uint color)
{          
  uint i,j; 
  LCD_Address_set(xsta,ysta,xend,yend);
  for(i=ysta;i<=yend;i++)
  {													   	 	
    for(j=xsta;j<=xend;j++)LCD_WR_DATA(color);    
  } 					  	    
}  

void LCD_DrawLine(uint x1, uint y1, uint x2, uint y2)
{
  uint t; 
  int xerr=0,yerr=0,delta_x,delta_y,distance; 
  int incx,incy,uRow,uCol; 
  delta_x=x2-x1;
  delta_y=y2-y1; 
  uRow=x1; 
  uCol=y1; 
  if(delta_x>0)incx=1;
  else if(delta_x==0)incx=0;
  else {incx=-1;delta_x=-delta_x;} 
  if(delta_y>0)incy=1; 
  else if(delta_y==0)incy=0;
  else{incy=-1;delta_y=-delta_y;} 
  if( delta_x>delta_y)distance=delta_x; 
  else distance=delta_y; 
  for(t=0;t<=distance+1;t++ )
  {  
    LCD_DrawPoint(uRow,uCol);
    xerr+=delta_x ; 
    yerr+=delta_y ;  
    if(xerr>distance) 
    { 	
      xerr-=distance; 	
      uRow+=incx; 
    } 
    if(yerr>distance) 
    { 	
      yerr-=distance; 	
      uCol+=incy; 	
    } 
  }  
}    

void LCD_DrawRectangle(uint x1, uint y1, uint x2, uint y2)
{
  LCD_DrawLine(x1,y1,x2,y1);
  LCD_DrawLine(x1,y1,x1,y2);
  LCD_DrawLine(x1,y2,x2,y2);
  LCD_DrawLine(x2,y1,x2,y2);
}

void LCD_ShowChar(uint x,uint y,uchar num,uchar mode)
{
    uchar temp;
    uchar pos,t;
    uint x0=x;
    uint colortemp=POINT_COLOR;      
    if(x>LCD_W-16||y>LCD_H-16)return; 
    num=num-' ';
    LCD_Address_set(x,y,x+8-1,y+16-1);
    if(!mode)
    {
      for(pos=0;pos<16;pos++)
      { 
        temp=asc2_1608[(uint)num*16+pos];
        for(t=0;t<8;t++)
        {                 
          if(temp&0x01)
            POINT_COLOR=colortemp;
          else 
            POINT_COLOR=BACK_COLOR;
          LCD_WR_DATA(POINT_COLOR);	
          temp>>=1; 
          x++;
        }
        x=x0;
        y++;
      }	
    }
    else
    {
      for(pos=0;pos<16;pos++)
      {
        temp=asc2_1608[(uint)num*16+pos];
	for(t=0;t<8;t++)
        {   
          if(temp&0x01)LCD_DrawPoint(x+t,y+pos);
          temp>>=1; 
        }
      }
    }
    POINT_COLOR=colortemp;	    	   	 	  
}   

ulong mypow(uchar m,uchar n)
{
  ulong result=1;	 
  while(n--)result*=m;    
  return result;
}			 

void LCD_ShowNum(uint x,uint y,ulong num,uchar len)
{         	
  uchar t,temp;
  uchar enshow=0;
  num=(uint)num;
  for(t=0;t<len;t++)
  {
    temp=(num/mypow(10,len-t-1))%10;
    if(enshow==0&&t<(len-1))
    {
      if(temp==0)
      {
        LCD_ShowChar(x+8*t,y,' ',0);	
        continue;
      }else enshow=1; 
    }
    LCD_ShowChar(x+8*t,y,temp+48,0); 
  }
} 
 
void LCD_Show2Num(uint x,uint y,uint num,uchar len)
{         	
  uchar t,temp;						   
  for(t=0;t<len;t++)
  {
    temp=(num/mypow(10,len-t-1))%10;
    LCD_ShowChar(x+8*t,y,temp+'0',0); 
  }
} 

void LCD_ShowString(uint x,uint y,const uchar *p)
{         
  while(*p!='\0')
  {       
    if(x>LCD_W-16){x=0;y+=16;}
    if(y>LCD_H-16){y=x=0;LCD_Clear(RED);}
    LCD_ShowChar(x,y,*p,0);
    x+=8;
    p++;
  }  
}

unsigned char hanzi[]={			  
0x00,0x00,0x00,0x00,0x00,0x00,0x00,0x00,0x00,0x00,0x80,0x00,0x00,0xFE,0xFF,0x01,
0x00,0xFE,0xFF,0x01,0x00,0x06,0xC0,0x00,0x00,0x06,0xC0,0x00,0x00,0x06,0xC0,0x00,
0x00,0xFE,0xFF,0x00,0x00,0x06,0xC0,0x00,0x00,0x06,0xC0,0x00,0x00,0x06,0xC0,0x00,
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0x04,0xC2,0xFF,0x3F,0x06,0xC0,0x01,0x00,0x02,0xC0,0x01,0x00,0x00,0x00,0x00,0x00,
};

const unsigned char image[]={ /* 0X00,0X10,0X28,0X00,0X28,0X00,0X01,0X1B,*/
0XFF,0XFF,0XFF,0XFF,0XFF,0XFF,0XFF,0XFF,0XFF,0XFF,0XFF,0XFF,0XFF,0XFF,0XFF,0XFF,
0XFF,0XFF,0XFF,0XFF,0XFF,0XFF,0XFF,0XFF,0XFF,0XFF,0XFF,0XFF,0XBE,0XF7,0X7D,0XEF,
0XBA,0XD6,0XB6,0XB5,0XF3,0X9C,0XB2,0X94,0XB3,0X9C,0XB2,0X94,0X34,0XA5,0XF7,0XBD,
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0XB7,0XAD,0X79,0XC6,0X3C,0XE7,0XBE,0XF7,0XFF,0XFF,0XFF,0XFF,0XFF,0XFF,0XFF,0XFF,
};

void showhanzi(unsigned int x,unsigned int y,unsigned char index)	
{  
  unsigned char i,j;
  unsigned char *temp=hanzi;    
  LCD_Address_set(x,y,x+31,y+31); //éè????óò      
  temp+=index*128;	
  for(j=0;j<128;j++)
  {
    for(i=0;i<8;i++)
    { 		     
      if((*temp&(1<<i))!=0)
      {
        LCD_WR_DATA(POINT_COLOR);
      } 
      else
      {
        LCD_WR_DATA(BACK_COLOR);
      }   
    }
    temp++;
  }
}

unsigned int  vx=7724,vy=12970;  //±èàyòò×ó￡?′??μ3yò?1000??oó±íê??àéù??AD?μ′ú±íò???????μ?
unsigned int chx=3872,chy=3763;//??è?????μ?×?±ê?a0ê±μ?AD?eê??μ

void xianshi()//??ê?D??￠
{   
  unsigned int lx,ly;
  BACK_COLOR=WHITE;
  POINT_COLOR=RED;	
  showhanzi(10,0,0);  //?§
  showhanzi(45,0,1);  //ò?
  LCD_ShowString(10,35,"http://ttmcu.taobao.com");
  LCD_ShowString(10,55,"LCD_W:");	
  LCD_ShowNum(70,55,LCD_W,3);
  LCD_ShowString(110,55,"LCD_H:");
  LCD_ShowNum(160,55,LCD_H,3);	
  lx=10;ly=75;			
  LCD_ShowString(lx,ly,"VX:");lx+=40;
  LCD_ShowNum(lx,ly,vx,5);					
  lx+=60;
  LCD_ShowString(lx,ly,"Vy:");lx+=40;
  LCD_ShowNum(lx,ly,vy,5);					
  lx=10;ly=95; 
  LCD_ShowString(lx,ly,"CHX:");lx+=40;
  LCD_ShowNum(lx,ly,chx,5);					
  lx+=60; 
  LCD_ShowString(lx,ly,"CHY:");lx+=40;
  LCD_ShowNum(lx,ly,chy,5);
}


void showimage(void) 
{
  int i,j,k; 
  LCD_Clear(WHITE); //???á  
  xianshi(); //??ê?D??￠
  for(k=3;k<6;k++)
  {
    for(j=0;j<12;j++)
    {	
      LCD_Address_set(40*j,40*k,40*j+39,40*k+39);		//×?±êéè??
      for(i=0;i<1600;i++)
      { 		
        LCD_WR_DATA8(image[i*2+1],image[i*2]);	 //·￠?í??é?êy?Y?aìá???ù?è??8??μí8??·?±e′?μY	   						
      }	
    }
  }		
}